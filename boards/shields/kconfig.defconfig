## boards/shields/kconfig.defconfig
```kconfig
if SHIELD_theduplex_LEFT

# Name must be less than 16 characters long!
config ZMK_theduplex
    default "theduplex"

config ZMK_SPLIT_ROLE_CENTRAL
    default y

endif

if SHIELD_theduplex_LEFT || SHIELD_theduplex_RIGHT

config ZMK_SPLIT
    default y

endif
```

## boards/shields/kconfig.shield
```kconfig
# No whitespace after the comma or in your part name!
config SHIELD_theduplex_LEFT
    def_bool $(shields_list_contains,theduplex_left)

# No whitespace after the comma or in your part name!
config SHIELD_theduplex_RIGHT
    def_bool $(shields_list_contains,theduplex_right)
```
